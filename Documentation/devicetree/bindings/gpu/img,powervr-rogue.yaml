## Documentation/devicetree/bindings/gpu/img,powervr-rogue.yaml
```yaml
# SPDX-License-Identifier: (GPL-2.0-only OR BSD-2-Clause)
# Copyright (c) 2023 Imagination Technologies Ltd.
%YAML 1.2
---
$id: http://devicetree.org/schemas/gpu/img,powervr-rogue.yaml#
$schema: http://devicetree.org/meta-schemas/core.yaml#

title: Imagination Technologies PowerVR and IMG Rogue GPUs

maintainers:
  - Frank Binns <frank.binns@imgtec.com>

properties:
  compatible:
    oneOf:
      - items:
          - enum:
              - ti,am62-gpu
          - const: img,img-axe # IMG AXE GPU model/revision is fully discoverable
      - items:
          - enum:
              - thead,th1520-gpu
          - const: img,img-bxm

  reg:
    maxItems: 1

  clocks:
    minItems: 1
    maxItems: 3

  clock-names:
    items:
      - const: core
      - const: mem
      - const: sys
    minItems: 1

  interrupts:
    maxItems: 1

  power-domains:
    maxItems: 1

  resets:
    maxItems: 1

required:
  - compatible
  - reg
  - clocks
  - clock-names
  - interrupts

additionalProperties: false

allOf:
  - if:
      properties:
        compatible:
          contains:
            const: ti,am62-gpu
    then:
      properties:
        clocks:
          maxItems: 1

  - if:
      properties:
        compatible:
          contains:
            const: thead,th1520-gpu
    then:
      properties:
        clocks:
          minItems: 3

examples:
  - |
    #include <dt-bindings/interrupt-controller/irq.h>
    #include <dt-bindings/interrupt-controller/arm-gic.h>
    #include <dt-bindings/soc/ti,sci_pm_domain.h>

    gpu@fd00000 {
        compatible = "ti,am62-gpu", "img,img-axe";
        reg = <0x0fd00000 0x20000>;
        clocks = <&k3_clks 187 0>;
        clock-names = "core";
        interrupts = <GIC_SPI 86 IRQ_TYPE_LEVEL_HIGH>;
        power-domains = <&k3_pds 187 TI_SCI_PD_EXCLUSIVE>;
    };

    #include <dt-bindings/clock/thead,th1520-clk-ap.h>
    #include <dt-bindings/power/thead,th1520-power.h>
    #include <dt-bindings/reset/thead,th1520-reset.h>

    gpu: gpu@fff0000 {
        compatible = "thead,th1520-gpu", "img,img-bxm";
        reg = <0xfff0000 0x1000>;
        interrupt-parent = <&plic>;
        interrupts = <102 IRQ_TYPE_LEVEL_HIGH>;
        clocks = <&clk CLK_GPU_CORE>, <&clk CLK_GPU_MEM>,
                 <&clk CLK_GPU_CFG_ACLK>;
        clock-names = "core", "mem", "sys";
        power-domains = <&pd TH1520_GPU_PD>;
        resets = <&rst TH1520_RESET_ID_GPU>;
    };
```
