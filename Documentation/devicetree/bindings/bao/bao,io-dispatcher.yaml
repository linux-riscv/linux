## Documentation/devicetree/bindings/bao/bao,io-dispatcher.yaml
```yaml
# SPDX-License-Identifier: GPL-2.0-only OR BSD-2-Clause
%YAML 1.2
---
$id: http://devicetree.org/schemas/bao/bao,io-dispatcher.yaml#
$schema: http://devicetree.org/meta-schemas/core.yaml#

title: Bao Hypervisor I/O Dispatcher Device

maintainers:
  - João Peixoto <jpeixoto@osyx.tech>
  - José Martins <jose@osyx.tech>
  - David Cerdeira <davidmcerdeira@osyx.tech>

description:
  Backend device exposed by the Bao hypervisor to a guest that services
  paravirtualised (VirtIO) I/O on behalf of a frontend guest. Each device
  owns one contiguous shared-memory region used to exchange I/O buffers
  with its frontend, and one interrupt the hypervisor raises to signal a
  pending I/O request. A backend guest that services several frontends
  instantiates one node per backend device.

properties:
  compatible:
    const: bao,io-dispatcher

  reg:
    maxItems: 1
    description:
      Shared-memory region used to exchange I/O buffers with the frontend.

  interrupts:
    maxItems: 1
    description:
      Interrupt raised by the hypervisor to signal a pending I/O request.

  bao,id:
    $ref: /schemas/types.yaml#/definitions/uint32
    description:
      Hypervisor-assigned identifier of the backend device model. It must
      match the identifier configured for the device model in the
      hypervisor.

required:
  - compatible
  - reg
  - interrupts
  - bao,id

additionalProperties: false

examples:
  - |
    shmem@50000000 {
        compatible = "bao,io-dispatcher";
        reg = <0x50000000 0x01000000>;
        interrupts = <0x0 0x08 0x1>;
        bao,id = <0>;
    };
```

## Documentation/devicetree/bindings/bao/bao,ipcshmem.yaml
```yaml
# SPDX-License-Identifier: GPL-2.0-only OR BSD-2-Clause
%YAML 1.2
---
$id: http://devicetree.org/schemas/bao/bao,ipcshmem.yaml#
$schema: http://devicetree.org/meta-schemas/core.yaml#

title: Bao Hypervisor IPC Shared Memory Device

maintainers:
  - João Peixoto <jpeixoto@osyx.tech>
  - José Martins <jose@osyx.tech>
  - David Cerdeira <davidmcerdeira@osyx.tech>

description: |
  Shared-memory device exposed by the Bao hypervisor to a guest so that it
  can exchange data with a peer guest. The hypervisor provides two
  contiguous memory regions, one the guest reads from (written by the peer)
  and one the guest writes to (read by the peer). A write is signalled to
  the peer through a hypercall identified by bao,id.

properties:
  compatible:
    const: bao,ipcshmem

  reg:
    items:
      - description: region read by this guest and written by the peer
      - description: region written by this guest and read by the peer

  reg-names:
    items:
      - const: read
      - const: write

  bao,id:
    $ref: /schemas/types.yaml#/definitions/uint32
    description:
      Hypervisor-assigned identifier of this shared-memory channel. The
      guest passes it to the Bao hypercall that notifies the peer of a
      write, so it must match the identifier configured for the channel in
      the hypervisor.

required:
  - compatible
  - reg
  - reg-names
  - bao,id

additionalProperties: false

examples:
  - |
    shmem@f0000000 {
        compatible = "bao,ipcshmem";
        reg = <0xf0000000 0x2000>,
              <0xf0002000 0x2000>;
        reg-names = "read", "write";
        bao,id = <0>;
    };
```

## Documentation/devicetree/bindings/crypto/cri,cmh.yaml
```yaml
# SPDX-License-Identifier: (GPL-2.0-only OR BSD-2-Clause)
%YAML 1.2
---
$id: http://devicetree.org/schemas/crypto/cri,cmh.yaml#
$schema: http://devicetree.org/meta-schemas/core.yaml#

title: CRI CryptoManager Hub (CMH) Hardware Crypto Accelerator

maintainers:
  - Alex Ousherovitch <aousherovitch@rambus.com>
  - Saravanakrishnan Krishnamoorthy <skrishnamoorthy@rambus.com>
  - Joel Wittenauer <Joel.Wittenauer@cryptography.com>

description: |
  The CRI CryptoManager Hub (CMH) is a hardware cryptographic accelerator accessed
  via a mailbox-based VCQ (Virtual Command Queue) interface.  The host
  writes VCQ command sequences into per-mailbox DMA queue buffers and
  rings a doorbell; the CMH eSW processes them and signals completion
  via interrupt.

  Supported algorithm families: SHA-2, SHA-3, SM3, AES, SM4,
  ChaCha20-Poly1305, RSA, ECDSA, EdDSA, ECDH, SM2, ML-KEM, ML-DSA,
  SLH-DSA, LMS, XMSS, DRBG.

properties:
  compatible:
    const: cri,cmh

  reg:
    maxItems: 1
    description:
      SIC (System Interface Controller) MMIO region.  Mailbox instance
      registers are at offsets N * 0x1000 within this region.

  interrupts:
    minItems: 1
    maxItems: 64
    description:
      Per-mailbox completion/error interrupts from the CryptoManager Hub,
      matching the real CMH ch_sys_interrupt_mbx[N-1:0] topology.
      Entry i corresponds to MBX instance i.  The driver maps each
      configured mailbox (cri,mbx-instances) to its DT interrupt
      index and registers a separate threaded IRQ handler per MBX.

  interrupt-names:
    minItems: 1
    maxItems: 64
    items:
      pattern: '^mbx[0-9]+$'
    description:
      Names for each mailbox interrupt, matching the interrupts array.
      Format is "mbxN" where N is the mailbox instance index.

  cri,mbx-instances:
    $ref: /schemas/types.yaml#/definitions/uint32-array
    minItems: 1
    maxItems: 64
    description:
      Array of 0-based mailbox instance indices to configure.
      Each index N maps to register offset N * 0x1000 within the
      SIC region.  If absent, defaults to instances 0 and 1.

  cri,mbx-slots-log2:
    $ref: /schemas/types.yaml#/definitions/uint32-array
    minItems: 1
    maxItems: 64
    description:
      Per-mailbox slot count as log2.  Valid range 1..15.
      Array length must match cri,mbx-instances.
      Default is 5 (32 slots).

  cri,mbx-strides-log2:
    $ref: /schemas/types.yaml#/definitions/uint32-array
    minItems: 1
    maxItems: 64
    description:
      Per-mailbox stride (bytes per slot) as log2.  Valid range 7..10.
      Array length must match cri,mbx-instances.
      Default is 7 (128 bytes per slot).

  "#address-cells":
    const: 1

  "#size-cells":
    const: 0

patternProperties:
  "^(hc|aes|sm4|sm3|hcq|qse|pke|drbg|ccp)@[0-9a-f]+$":
    type: object
    description:
      Per-core-type child nodes.  Each child represents one crypto core
      instance available in the hardware.  The driver enumerates these at
      probe to discover which algorithm families are present.

    properties:
      reg:
        maxItems: 1
        description:
          Hardware core ID for this core type (e.g. 0x02 for HC, 0x03 for AES).
          Must match the CORE_ID_* values defined by the CMH hardware.

      cri,mbx:
        $ref: /schemas/types.yaml#/definitions/uint32
        description:
          Pin this core instance to a specific mailbox instance index.
          Multiple child nodes of the same core type may each specify a
          different cri,mbx value to spread instances across mailboxes.
          When absent, the driver auto-assigns a mailbox via round-robin
          across the instances listed in cri,mbx-instances.

    required:
      - reg

    additionalProperties: false

required:
  - compatible
  - reg
  - interrupts
  - "#address-cells"
  - "#size-cells"

additionalProperties: false

examples:
  - |
    soc {
        #address-cells = <2>;
        #size-cells = <2>;

        crypto@a4800000 {
            compatible = "cri,cmh";
            reg = <0x0 0xa4800000 0x0 0x41000>;
            interrupts = <1 2>;
            interrupt-names = "mbx0", "mbx1";
            cri,mbx-instances = <0 1>;
            cri,mbx-slots-log2 = <5 5>;
            cri,mbx-strides-log2 = <7 7>;
            #address-cells = <1>;
            #size-cells = <0>;

            hc@2 {
                reg = <0x02>;
            };

            aes@3 {
                reg = <0x03>;
            };

            sm4@4 {
                reg = <0x04>;
            };

            sm3@5 {
                reg = <0x05>;
            };

            hcq@8 {
                reg = <0x08>;
            };

            qse@9 {
                reg = <0x09>;
            };

            pke@a {
                reg = <0x0a>;
                cri,mbx = <1>;
            };

            drbg@f {
                reg = <0x0f>;
            };

            ccp@18 {
                reg = <0x18>;
            };
        };
    };

  - |
    /* Multi-instance: two AES cores on separate MBXes (future eSW support) */
    soc {
        #address-cells = <2>;
        #size-cells = <2>;

        crypto@a4800000 {
            compatible = "cri,cmh";
            reg = <0x0 0xa4800000 0x0 0x41000>;
            interrupts = <1 2>;
            interrupt-names = "mbx0", "mbx1";
            cri,mbx-instances = <0 1>;
            cri,mbx-slots-log2 = <5 5>;
            cri,mbx-strides-log2 = <7 7>;
            #address-cells = <1>;
            #size-cells = <0>;

            hc@2 {
                reg = <0x02>;
            };

            aes@3 {
                reg = <0x03>;
                cri,mbx = <0>;
            };

            /* Second AES instance at core ID 0x06, pinned to MBX 1 */
            aes@6 {
                reg = <0x06>;
                cri,mbx = <1>;
            };

            pke@a {
                reg = <0x0a>;
                cri,mbx = <1>;
            };

            drbg@f {
                reg = <0x0f>;
            };
        };
    };
```

## Documentation/devicetree/bindings/crypto/rambus,cmh-v1030.yaml
```yaml
# SPDX-License-Identifier: (GPL-2.0-only OR BSD-2-Clause)
%YAML 1.2
---
$id: http://devicetree.org/schemas/crypto/rambus,cmh-v1030.yaml#
$schema: http://devicetree.org/meta-schemas/core.yaml#

title: Rambus CryptoManager Hub (CMH) Hardware Crypto Accelerator

maintainers:
  - Alex Ousherovitch <aousherovitch@rambus.com>
  - Saravanakrishnan Krishnamoorthy <skrishnamoorthy@rambus.com>
  - Joel Wittenauer <Joel.Wittenauer@cryptography.com>

description: |
  The Rambus CryptoManager Hub (CMH) is a hardware cryptographic accelerator
  accessed via a mailbox-based VCQ (Virtual Command Queue) interface.  The
  host writes VCQ command sequences into per-mailbox DMA queue buffers and
  rings a doorbell; the CMH eSW processes them and signals completion via
  interrupt.

  The management host statically partitions the hardware mailboxes across
  the SoC's host interfaces at integration time; the set of mailboxes a
  given host owns is therefore fixed and not runtime-discoverable (a
  mailbox locked to a host reads as unavailable in the SIC availability
  register).  Each owned mailbox is described by a child node.  Which
  crypto cores are present is a fixed silicon-build property indicated by
  the SIC CORE_ENABLE register, so cores are not described in the device
  tree.  Clock and reset are owned by the management host; a node
  describing a non-management host has no clock or reset provider of its
  own, so clocks and reset-gpios are optional.

  CMH gates access to a locked mailbox by a hardware HOST ID presented on
  the bus with every access, permitting only the owning host's ID.  An
  integration must present a single, stable HOST ID for all accesses to a
  given mailbox, independent of the issuing CPU (relevant on SMP hosts
  whose interconnect encodes the issuing CPU in the HOST ID).

properties:
  compatible:
    items:
      - not: {}
        description: SoC-specific compatible, e.g. vendor,soc-cmh
      - const: rambus,cmh-v1030

  reg:
    maxItems: 1
    description:
      SIC (System Interface Controller) MMIO region.  The registers of
      mailbox instance N are at offset N * 0x1000 within this region.

  clocks:
    minItems: 1
    maxItems: 3
    description:
      The "core" functional clock, and optionally the half-rate "core-div2"
      clock (present only on configurations with side-channel-protected
      cores) and/or the "rt" real-time tick clock.  See clock-names for the
      valid combinations.

  clock-names:
    oneOf:
      - items:
          - const: core
      - items:
          - const: core
          - const: core-div2
      - items:
          - const: core
          - const: rt
      - items:
          - const: core
          - const: core-div2
          - const: rt

  reset-gpios:
    maxItems: 1
    description:
      Host-controlled reset for the CryptoManager Hub.  The hub has two
      external, active-low reset inputs -- a power-on reset and a hard
      reset; where a board routes one of them to a host GPIO, that line is
      described here.

  "#address-cells":
    const: 1

  "#size-cells":
    const: 0

patternProperties:
  "^queue@[0-9a-f]+$":
    type: object
    description:
      One node per hardware mailbox (VCQ command queue) this host owns.
      The set of owned mailboxes is fixed by the management host at
      integration time and enumerated here.
    properties:
      reg:
        maxItems: 1
        description:
          0-based mailbox instance index.  The instance's registers are
          at reg * 0x1000 within the SIC region.

      interrupts:
        maxItems: 1
        description: Completion/error interrupt for this mailbox.

      rambus,num-slots:
        $ref: /schemas/types.yaml#/definitions/uint32
        enum: [2, 4, 8, 16, 32, 64, 128, 256, 512, 1024, 2048, 4096, 8192,
               16384, 32768]
        default: 64
        description:
          Number of VCQ ring slots for this mailbox's command queue in
          host DMA memory.  This is a per-board, per-mailbox host-memory
          ring geometry -- boards built around the same SoC (hence the
          same compatible) may use different ring sizes, so it is
          described per mailbox rather than derived from the compatible.

      rambus,slot-stride-bytes:
        $ref: /schemas/types.yaml#/definitions/uint32
        enum: [128, 256, 512, 1024]
        default: 512
        description:
          Stride in bytes between consecutive VCQ ring slots for this
          mailbox's command queue.  Like rambus,num-slots this is a
          per-board host-memory ring geometry, not derived from the
          compatible.

      rambus,cores:
        $ref: /schemas/types.yaml#/definitions/string-array
        items:
          enum: [hc, aes, sm4, sm3, hcq, qse, pke, ccp]
        description: |
          Core-affinity list: the crypto cores whose work is dispatched to
          this mailbox.  A core may appear on at most one mailbox.  Cores
          not listed on any mailbox are load-balanced across all mailboxes.
          Optional (default: none -- the mailbox only serves the
          load-balanced pool).

    required:
      - reg

    additionalProperties: false

required:
  - compatible
  - reg
  - "#address-cells"
  - "#size-cells"

additionalProperties: false
```
