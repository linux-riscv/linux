## Documentation/devicetree/bindings/soc/microchip/microchip,mpfs-irqmux.yaml
```yaml
# SPDX-License-Identifier: (GPL-2.0-only OR BSD-2-Clause)
%YAML 1.2
---
$id: http://devicetree.org/schemas/soc/microchip/microchip,mpfs-irqmux.yaml#
$schema: http://devicetree.org/meta-schemas/core.yaml#

title: Microchip Polarfire SoC GPIO Interrupt Mux

maintainers:
  - Conor Dooley <conor.dooley@microchip.com>

description: |
  There are 3 GPIO controllers on this SoC, of which:
  - GPIO controller 0 has 14 GPIOs
  - GPIO controller 1 has 24 GPIOs
  - GPIO controller 2 has 32 GPIOs

  All GPIOs are capable of generating interrupts, for a total of 70.
  There are only 41 IRQs available however, so a configurable mux is used to
  ensure all GPIOs can be used for interrupt generation.
  38 of the 41 interrupts are in what the documentation calls "direct mode",
  as they provide an exclusive connection from a GPIO to the PLIC.
  Lines 18 to 23 on GPIO controller 1 are always in "direct mode".
  The 3 remaining interrupts are used to mux the interrupts which do not have
  a exclusive connection, one for each GPIO controller.

properties:
  compatible:
    const: microchip,mpfs-irqmux

  reg:
    maxItems: 1

  "#address-cells":
    const: 0

  "#interrupt-cells":
    const: 1

  interrupt-map-mask:
    items:
      - const: 0x7f

  interrupt-map:
    description: |
      Specifies the mapping from GPIO interrupt lines to plic interrupts.

      The child interrupt number set in arrays items is computed using the
      following formula:
          gpio_bank * 32 + gpio_number
      with:
        - gpio_bank: The GPIO bank number
            - 0 for GPIO0,
            - 1 for GPIO1,
            - 2 for GPIO2
        - gpio_number: Number of the gpio in the bank (0..31)
    maxItems: 70

required:
  - compatible
  - reg
  - "#address-cells"
  - "#interrupt-cells"
  - interrupt-map-mask
  - interrupt-map

additionalProperties: false

examples:
  - |
    interrupt-controller@54 {
        compatible = "microchip,mpfs-irqmux";
        reg = <0x54 0x4>;
        #address-cells = <0>;
        #interrupt-cells = <1>;
        interrupt-map-mask = <0xff>;
    };
```

## Documentation/devicetree/bindings/tee/riscv,rpmi-mpxy-tee.yaml
```yaml
# SPDX-License-Identifier: (GPL-2.0-only OR BSD-2-Clause)
# Copyright (c) Qualcomm Technologies, Inc. and/or its subsidiaries.
%YAML 1.2
---
$id: http://devicetree.org/schemas/tee/riscv,rpmi-mpxy-tee.yaml#
$schema: http://devicetree.org/meta-schemas/core.yaml#

title: RISC-V RPMI TEE service group based message proxy

maintainers:
  - Amirreza Zarrabi <amirreza.zarrabi@oss.qualcomm.com>

description: |
  The RISC-V Platform Management Interface (RPMI) [1] defines a messaging
  protocol which is modular and extensible. The supervisor software can
  send/receive RPMI messages via the SBI MPXY extension [2] or some dedicated
  supervisor-mode RPMI transport.

  The RPMI specification [1] defines a TEE service group which is the RISC-V
  analog of Arm FF-A: OP-TEE and the rich execution environment (REE, i.e.
  Linux) are peer endpoints and the RPMI framework (machine mode firmware)
  mediates every message. Entering OP-TEE on a hart runs it on that hart until
  it responds, so the SBI implementation provides one SBI MPXY channel per
  hart; all of them are listed, in hart order, on a single node.

  ===========================================
  References
  ===========================================

  [1] RISC-V Platform Management Interface (RPMI) v1.0 (or higher)
      https://github.com/riscv-non-isa/riscv-rpmi/releases

  [2] RISC-V Supervisor Binary Interface (SBI) v3.0 (or higher)
      https://github.com/riscv-non-isa/riscv-sbi-doc/releases

properties:
  compatible:
    const: riscv,rpmi-mpxy-tee

  mboxes:
    minItems: 1
    description:
      One SBI MPXY channel implementing the RPMI TEE service group per hart,
      listed in the same order as the CPU nodes.

  interrupts:
    maxItems: 1
    description:
      Availability doorbell raised by OP-TEE to signal asynchronous
      notifications over the RPMI TEE signal bus. Optional; when absent
      asynchronous notification is disabled.

required:
  - compatible
  - mboxes

additionalProperties: false

examples:
  - |
    tee {
        compatible = "riscv,rpmi-mpxy-tee";
        mboxes = <&mpxy_mbox 0x10 0x0>, <&mpxy_mbox 0x11 0x0>;
    };
...
```

## arch/riscv/events/Kconfig
```kconfig
# SPDX-License-Identifier: GPL-2.0
menu "Performance monitoring"

config PERF_EVENTS_RISCV_TRACE
	tristate "RISCV TRACE events"
	depends on PERF_EVENTS && RISCV
	default m
	help
	  Include support for riscv trace events.

endmenu
```

## drivers/firmware/riscv/Kconfig
```kconfig
# SPDX-License-Identifier: GPL-2.0-only
menu "Risc-V Specific firmware drivers"
depends on RISCV

config RISCV_SBI_SSE
	bool "Enable SBI Supervisor Software Events support"
	depends on RISCV_SBI
	default y
	help
	  The Supervisor Software Events support allows the SBI to deliver
	  NMI-like notifications to the supervisor mode software. When enabled,
	  this option provides support to register callbacks on specific SSE
	  events.

config RISCV_SSE_NMI
	bool "Enable SBI Supervisor Software Events NMI support"
	depends on RISCV_SBI_SSE && SMP
	default y
	help
	  This option enables support for delivering Non-Maskable Interrupt
	  (NMI) notifications through the Supervisor Software Events (SSE)
	  framework. When enabled, the system can deliver local, unknown and
	  other types of NMIs.

endmenu
```

## drivers/iommu/riscv/Kconfig
```kconfig
# SPDX-License-Identifier: GPL-2.0-only
# RISC-V IOMMU support

config RISCV_IOMMU
	bool "RISC-V IOMMU Support"
	depends on RISCV && 64BIT
	default y
	select IOMMU_API
	help
	  Support for implementations of the RISC-V IOMMU architecture that
	  complements the RISC-V MMU capabilities, providing similar address
	  translation and protection functions for accesses from I/O devices.

	  Say Y here if your SoC includes an IOMMU device implementing
	  the RISC-V IOMMU architecture.

config RISCV_IOMMU_PCI
	def_bool y if RISCV_IOMMU && PCI_MSI
	help
	  Support for the PCIe implementation of RISC-V IOMMU architecture.

config RISCV_IOMMU_HPM
	tristate "RISCV IOMMU HPM support"
	depends on RISCV_IOMMU
	help
	  Provides support for the RISC-V IOMMU Hardware Performance Monitor
	  (HPM), which provide monitoring of transactions passing through the
	  IOMMU and allow the resulting information to be filtered based on
	  the device/process ID of the corresponding master.
```

## drivers/media/platform/sunxi/sun20i-csi/Kconfig
```kconfig
# SPDX-License-Identifier: GPL-2.0-only
config VIDEO_SUN20I_CSI
	tristate "Allwinner D1 CMOS Sensor Interface Controller (CSIC) Driver"
	depends on V4L_PLATFORM_DRIVERS && VIDEO_DEV
	depends on ARCH_SUNXI || COMPILE_TEST
	depends on PM && COMMON_CLK && RESET_CONTROLLER && HAS_DMA
	select MEDIA_CONTROLLER
	select VIDEO_V4L2_SUBDEV_API
	select VIDEOBUF2_DMA_CONTIG
	select V4L2_FWNODE
	help
	  Support for the parallel camera interface of the Allwinner D1
	  CMOS Sensor Interface Controller (CSIC), also found on the D1s
	  and the T113.

	  To compile this driver as a module, choose M here: the module
	  will be called sun20i-csi.
```

## drivers/virt/bao/io-dispatcher/Kconfig
```kconfig
# SPDX-License-Identifier: GPL-2.0
config BAO_IO_DISPATCHER
	tristate "Bao Hypervisor I/O Dispatcher"
	select EVENTFD
	help
	  The Bao I/O Dispatcher is a kernel module for backend Linux VMs
	  running under the Bao hypervisor. It establishes the connection
	  between the Remote I/O system (Bao's mechanism for forwarding
	  I/O requests from frontend VMs to the backend VMs) and the
	  VirtIO backend device.

	  This provides a unified API to support various VirtIO backends,
	  allowing Bao guests to perform I/O through the hypervisor
	  transparently.
```

## drivers/virt/bao/ipcshmem/Kconfig
```kconfig
# SPDX-License-Identifier: GPL-2.0
config BAO_SHMEM
	tristate "Bao hypervisor shared memory support"
	depends on HAVE_ARM_SMCCC || RISCV
	help
	  This enables support for Bao shared memory communication.
	  It allows the kernel to interface with guests running under
	  the Bao hypervisor, providing a character device interface
	  for exchanging data through dedicated shared-memory regions.
	  Channels are declared on the kernel command line via
	  "bao_ipcshmem.channels=".

	  To compile this driver as a module, choose M here: the module
	  will be called bao_ipcshmem.

	  If unsure, say N.
```
