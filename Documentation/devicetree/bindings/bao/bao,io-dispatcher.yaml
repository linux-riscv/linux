## Documentation/devicetree/bindings/dma/marvell,mmp-dma.yaml
```yaml
# SPDX-License-Identifier: (GPL-2.0-only OR BSD-2-Clause)
%YAML 1.2
---
$id: http://devicetree.org/schemas/dma/marvell,mmp-dma.yaml#
$schema: http://devicetree.org/meta-schemas/core.yaml#

title: Marvell MMP DMA controller

maintainers:
  - Duje Mihanović <duje.mihanovic@skole.hr>

description:
  Marvell MMP SoCs may have two types of DMA controllers, peripheral and audio.

properties:
  compatible:
    enum:
      - marvell,pdma-1.0
      - marvell,adma-1.0
      - marvell,pxa910-squ
      - spacemit,pdma-1.0

  reg:
    maxItems: 1

  interrupts:
    description:
      Interrupt lines for the controller, may be shared or one per DMA channel
    minItems: 1

  asram:
    description:
      A phandle to the SRAM pool
    $ref: /schemas/types.yaml#/definitions/phandle

  clocks:
    description: Clock for the controller
    maxItems: 1

  resets:
    description: Reset controller for the DMA controller
    maxItems: 1

  '#dma-cells':
    const: 2
    description:
      The first cell contains the DMA request number for the peripheral
      device. The second cell is currently unused but must be present for
      backward compatibility.

  '#dma-channels':
    deprecated: true

  '#dma-requests':
    deprecated: true

required:
  - compatible
  - reg
  - interrupts
  - '#dma-cells'

allOf:
  - $ref: dma-controller.yaml#
  - if:
      properties:
        compatible:
          contains:
            enum:
              - marvell,pdma-1.0
              - spacemit,pdma-1.0
    then:
      properties:
        asram: false
    else:
      required:
        - asram

unevaluatedProperties: false

examples:
  - |
    dma-controller@d4000000 {
        compatible = "marvell,pdma-1.0";
        reg = <0xd4000000 0x10000>;
        interrupts = <47>;
        #dma-cells = <2>;
        dma-channels = <16>;
    };
```

## Documentation/devicetree/bindings/firmware/linaro,optee-rpmi.yaml
```yaml
# SPDX-License-Identifier: (GPL-2.0 OR BSD-2-Clause)
%YAML 1.2
---
$id: http://devicetree.org/schemas/firmware/linaro,optee-rpmi.yaml#
$schema: http://devicetree.org/meta-schemas/core.yaml#

title: OP-TEE accessed through the RISC-V RPMI TEE service group

maintainers:
  - Marouene Boubakri <marouene.boubakri@oss.nxp.com>

description: |
  OP-TEE is a piece of software using hardware features to provide a Trusted
  Execution Environment. On RISC-V, OP-TEE runs as a supervisor domain
  isolated from the Rich Execution Environment (REE) by the M-mode firmware.

  The REE reaches OP-TEE through the TEE service group of the RISC-V Platform
  Management Interface (RPMI) [1], carried on a channel of the SBI Message
  Proxy (MPXY) extension [2]. Each call into OP-TEE is a TEE_CALL service
  request whose service data carries the register arguments of the OP-TEE
  SMC ABI (drivers/tee/optee/optee_smc.h), as described in
  drivers/tee/optee/optee_rpmi.h.

  The RPMI TEE framework (the M-mode firmware) assigns an identifier to each
  endpoint. The identifiers of the REE and of OP-TEE are required to
  address TEE_CALL requests and are described here.

  The compatible string uses the same "linaro" vendor prefix as
  "linaro,optee-tz", which identifies the OP-TEE reference implementation.

  [1] RISC-V Platform Management Interface (RPMI) v2.0 (or higher)
      https://github.com/riscv-non-isa/riscv-rpmi/releases

  [2] RISC-V Supervisor Binary Interface (SBI) v3.0 (or higher)
      https://github.com/riscv-non-isa/riscv-sbi-doc/releases

properties:
  $nodename:
    const: optee

  compatible:
    const: linaro,optee-rpmi

  mboxes:
    maxItems: 1
    description:
      SBI MPXY channel implementing the RPMI TEE service group.

  riscv,rpmi-tee-sender-id:
    $ref: /schemas/types.yaml#/definitions/uint32
    description:
      Endpoint identifier of the REE, used as SENDER_ID of the TEE_CALL
      requests.

  riscv,rpmi-tee-target-id:
    $ref: /schemas/types.yaml#/definitions/uint32
    description:
      Endpoint identifier of OP-TEE, used as TARGET_ID of the TEE_CALL
      requests.

required:
  - compatible
  - mboxes
  - riscv,rpmi-tee-sender-id
  - riscv,rpmi-tee-target-id

additionalProperties: false

examples:
  - |
    firmware {
        optee {
            compatible = "linaro,optee-rpmi";
            mboxes = <&mpxy_mbox 0x10 0x0>;
            riscv,rpmi-tee-sender-id = <0>;
            riscv,rpmi-tee-target-id = <1>;
        };
    };
...
```

## Documentation/devicetree/bindings/firmware/riscv,rpmi-performance.yaml
```yaml
# SPDX-License-Identifier: (GPL-2.0-only OR BSD-2-Clause)
%YAML 1.2
---
$id: http://devicetree.org/schemas/firmware/riscv,rpmi-performance.yaml#
$schema: http://devicetree.org/meta-schemas/core.yaml#

title: RISC-V RPMI performance service group based cpufreq controller

maintainers:
  - Joshua Yeong <joshua.yeong@starfivetech.com>

description: |
  The RISC-V Platform Management Interface (RPMI) [1] defines a modular and
  extensible messaging protocol for platform management functions. The supervisor
  software can send and receive RPMI messages via SBI MPXY extension [2]
  or via a dedicated supervisor-mode RPMI transport.

  The RPMI specification [1] defines performance service group (performance
  domain) for accessing and controlling platform-managed performance-related
  resources, as implemented by a platform microcontroller. Supervisor software
  can interact with the RPMI performance service group through an SBI MPXY
  channel or through a dedicated supervisor-mode RPMI transport.

  ===========================================
  References
  ===========================================

  [1] RISC-V Platform Management Interface (RPMI) v1.0 (or higher)
      https://github.com/riscv-non-isa/riscv-rpmi/releases

  [2] RISC-V Supervisor Binary Interface (SBI) v3.0 (or higher)
      https://github.com/riscv-non-isa/riscv-sbi-doc/releases

properties:
  compatible:
    description:
      Intended for use by the supervisor software.
    const: riscv,rpmi-performance

  mboxes:
    maxItems: 1
    description:
      Mailbox channel of the underlying RPMI transport or SBI message proxy channel.

  "#performance-domain-cells":
    const: 1

required:
  - compatible
  - mboxes
  - "#performance-domain-cells"

additionalProperties: false

examples:
  - |
    performance: rpmi-performance {
        compatible = "riscv,rpmi-performance";
        mboxes = <&mpxy_mbox 0x1001 0x0>;
        #performance-domain-cells = <0x01>;
    };
...
```

## Documentation/devicetree/bindings/media/allwinner,sun20i-d1-csi.yaml
```yaml
# SPDX-License-Identifier: (GPL-2.0-only OR BSD-2-Clause)
%YAML 1.2
---
$id: http://devicetree.org/schemas/media/allwinner,sun20i-d1-csi.yaml#
$schema: http://devicetree.org/meta-schemas/core.yaml#

title: Allwinner D1 CMOS Sensor Interface Controller (CSIC)

maintainers:
  - Nguyen Minh Tien <tien.nguyenminh@embeddedlinux.blog>

description:
  The CSIC found in the Allwinner D1, D1s and T113 receives video from a
  parallel camera interface and writes it to memory. It contains a parser for
  the camera bus and two DMA engines.

properties:
  compatible:
    const: allwinner,sun20i-d1-csi

  reg:
    maxItems: 1

  interrupts:
    items:
      - description: DMA engine 0
      - description: DMA engine 1
      - description: Parser 0
      - description: Top-level block (CSI_TOP_PKT)

  clocks:
    items:
      - description: Bus clock
      - description: Module clock
      - description: DRAM clock

  clock-names:
    items:
      - const: bus
      - const: mod
      - const: ram

  resets:
    maxItems: 1

  iommus:
    maxItems: 1

  port:
    $ref: /schemas/graph.yaml#/$defs/port-base
    description: Parallel input port, connect to a parallel sensor
    unevaluatedProperties: false

    properties:
      endpoint:
        $ref: video-interfaces.yaml#
        unevaluatedProperties: false

        properties:
          bus-width:
            const: 8

          pclk-sample: true
          hsync-active: true
          vsync-active: true

        required:
          - bus-width

required:
  - compatible
  - reg
  - interrupts
  - clocks
  - clock-names
  - resets
  - port

additionalProperties: false

examples:
  - |
    #include <dt-bindings/clock/sun20i-d1-ccu.h>
    #include <dt-bindings/interrupt-controller/irq.h>
    #include <dt-bindings/reset/sun20i-d1-ccu.h>

    csi@5800000 {
        compatible = "allwinner,sun20i-d1-csi";
        reg = <0x05800000 0x400000>;
        interrupts = <111 IRQ_TYPE_LEVEL_HIGH>,
                     <112 IRQ_TYPE_LEVEL_HIGH>,
                     <116 IRQ_TYPE_LEVEL_HIGH>,
                     <122 IRQ_TYPE_LEVEL_HIGH>;
        clocks = <&ccu CLK_BUS_CSI>,
                 <&ccu CLK_CSI_TOP>,
                 <&ccu CLK_MBUS_CSI>;
        clock-names = "bus", "mod", "ram";
        resets = <&ccu RST_BUS_CSI>;

        port {
            endpoint {
                remote-endpoint = <&ov5640_ep>;
                bus-width = <8>;
                hsync-active = <1>; /* Active high */
                vsync-active = <0>; /* Active low */
                pclk-sample = <1>;  /* Rising */
            };
        };
    };

...
```

## Documentation/devicetree/bindings/net/sophgo,cv1800b-mdio-mux.yaml
```yaml
# SPDX-License-Identifier: GPL-2.0-only OR BSD-2-Clause
%YAML 1.2
---
$id: http://devicetree.org/schemas/net/sophgo,cv1800b-mdio-mux.yaml#
$schema: http://devicetree.org/meta-schemas/core.yaml#

title: Sophgo CV1800B MDIO bus multiplexer

maintainers:
  - Inochi Amaoto <inochiama@gmail.com>

description:
  This MDIO bus multiplexer defines buses that could be internal as well as
  external to SoCs. The external mdio bus can be configured at different
  bus address.

allOf:
  - $ref: mdio-mux.yaml#

properties:
  compatible:
    const: sophgo,cv1800b-mdio-mux

  reg:
    maxItems: 1

required:
  - compatible
  - reg

unevaluatedProperties: false

examples:
  - |
    mdio@3009000 {
      compatible = "sophgo,cv1800b-mdio-mux";
      reg = <0x3009000 0x1000>;
      #address-cells = <1>;
      #size-cells = <0>;
      mdio-parent-bus = <&gmac0_mdio>;

      mdio@0 {
        #address-cells = <1>;
        #size-cells = <0>;
        reg = <0>;
      };
    };
```

## Documentation/devicetree/bindings/power/thead,th1520-pwrseq.yaml
```yaml
# SPDX-License-Identifier: (GPL-2.0-only OR BSD-2-Clause)
%YAML 1.2
---
$id: http://devicetree.org/schemas/power/thead,th1520-pwrseq.yaml#
$schema: http://devicetree.org/meta-schemas/core.yaml#

title: T-HEAD TH1520 GPU Power Sequencer

maintainers:
  - Michal Wilczynski <m.wilczynski@samsung.com>

description: |
  This binding describes the power sequencer for the T-HEAD TH1520 GPU.
  This sequencer handles the specific power-up and power-down sequences
  required by the GPU, including managing clocks and resets from both the
  sequencer and the GPU device itself.

properties:
  compatible:
    const: thead,th1520-gpu-pwrseq

  resets:
    description: A phandle to the GPU clock generator reset.
    maxItems: 1

  reset-names:
    const: gpu-clkgen

required:
  - compatible
  - resets
  - reset-names

additionalProperties: false

examples:
  - |
    gpu_pwrseq: pwrseq {
        compatible = "thead,th1520-gpu-pwrseq";
        resets = <&rst 0>;
        reset-names = "gpu-clkgen";
    };
```

## Documentation/devicetree/bindings/riscv/trace/riscv,trace,encoder.yaml
```yaml
# SPDX-License-Identifier: GPL-2.0-only OR BSD-2-Clause
%YAML 1.2
---
$id: http://devicetree.org/schemas/riscv/trace/riscv,trace,encoder.yaml#
$schema: http://devicetree.org/meta-schemas/core.yaml#

title: RISC-V Trace Encoder Controller

description: |
  riscv trace encoder controller description.

maintainers:
  - Chen Pei <cp0613@linux.alibaba.com>

properties:
  compatible:
    items:
      - const: riscv_trace,encoder-controller
  reg:
    description: A memory region containing registers for encoder controller

  cpu:
    description: CPU identifier associated with this encoder

  ports:
    description: Output port definitions

additionalProperties: true

examples:
  - |
    encoder0: trace_encoder@26001000 {
        compatible = "riscv_trace,encoder-controller";
        reg = <0x0 0x26001000 0x0 0x1000>;
        cpu = <&cpu0>;
        output_port {
            port0 {
                endpoint = <&funnel0>;
            };
        };
    };
```

## Documentation/devicetree/bindings/riscv/trace/riscv,trace,funnel.yaml
```yaml
# SPDX-License-Identifier: GPL-2.0-only OR BSD-2-Clause
%YAML 1.2
---
$id: http://devicetree.org/schemas/riscv/trace/riscv,trace,funnel.yaml#
$schema: http://devicetree.org/meta-schemas/core.yaml#

title: RISC-V Trace Funnel Controller

description: |
  riscv trace funnel controller description.

maintainers:
  - Chen Pei <cp0613@linux.alibaba.com>

properties:
  compatible:
    items:
      - const: riscv_trace,funnel-controller
  reg:
    description: A memory region containing registers for funnel controller

  ports:
    description: Input/Output port definitions

  level:
    description: Level of the funnel (e.g., 1 means close to the encoder)

additionalProperties: true

examples:
  - |
    funnel0: trace_funnel@26404000 {
        compatible = "riscv_trace,funnel-controller";
        reg = <0x0 0x26404000 0x0 0x1000>;
        level = <1>;
        input_port {
            port0 {
                endpoint = <&encoder0>;
            };
        };
        output_port {
            port0 {
                endpoint = <&sink0>;
            };
        };
    };
```

## Documentation/devicetree/bindings/riscv/trace/riscv,trace,sink.yaml
```yaml
# SPDX-License-Identifier: GPL-2.0-only OR BSD-2-Clause
%YAML 1.2
---
$id: http://devicetree.org/schemas/riscv/trace/riscv,trace,sink.yaml#
$schema: http://devicetree.org/meta-schemas/core.yaml#

title: RISC-V Trace Sink Controller

description: |
  riscv trace sink controller description.

maintainers:
  - Chen Pei <cp0613@linux.alibaba.com>

properties:
  compatible:
    items:
      - const: riscv_trace,sink-controller
  reg:
    description: A memory region containing registers for sink controller

  ports:
    description: Input port definitions

additionalProperties: true

examples:
  - |
    sink0: trace_sink@26401000 {
        compatible = "riscv_trace,sink-controller";
        reg = <0x0 0x26401000 0x0 0x1000>;
        input_port {
            port0 {
                endpoint = <&funnel0>;
            };
        };
    };
```
