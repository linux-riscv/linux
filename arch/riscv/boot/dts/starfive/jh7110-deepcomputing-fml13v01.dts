// SPDX-License-Identifier: GPL-2.0 OR MIT
/*
 * Copyright (C) 2024 DeepComputing (HK) Limited
 */

/dts-v1/;
#include "jh7110-common.dtsi"

/ {
	model = "DeepComputing FML13V01";
	compatible = "deepcomputing,fml13v01", "starfive,jh7110";
};

&usb0 {
	dr_mode = "host";
	status = "okay";
};

&usb_cdns3 {
       phys = <&usbphy0>, <&pciephy0>;
       phy-names = "cdns3,usb2-phy", "cdns3,usb3-phy";
};

